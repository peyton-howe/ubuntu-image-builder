// SPDX-License-Identifier: (GPL-2.0+ OR MIT)
/*
 * Keep the AP6275P's 32.768 kHz LPO (HYM8563 CLKOUT) running before the
 * PCIe link trains. rtc-hym8563 writes CLKOUT=0 at probe, and the only
 * consumers (brcmfmac, hci_bcm) enable it after the device is already up,
 * so when the RTC probes from the initramfs ahead of the PCIe host, link
 * training runs without the clock and fails ("Device found, but not
 * active"). Hang the WiFi and PCIe supplies off a regulator that holds the
 * clock on: the host then defers until the RTC has probed and the clock is
 * enabled.
 */

/ {
	wifi_lpo: regulator-wifi-lpo {
		compatible = "regulator-fixed-clock";
		clocks = <&hym8563>;
		regulator-name = "wifi_lpo";
		regulator-always-on;
		regulator-min-microvolt = <3300000>;
		regulator-max-microvolt = <3300000>;
		vin-supply = <&vcc_3v3_s3>;
	};
};

&vcc_wifi_pwren {
	vin-supply = <&wifi_lpo>;
};

&vcc3v3_pcie2x1l2 {
	vin-supply = <&vcc_wifi_pwren>;
};
