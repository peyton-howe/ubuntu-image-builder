// SPDX-License-Identifier: (GPL-2.0+ OR MIT)
/*
 * Sony IMX219, attached like the Pi overlay: imx219,port0
 *
 * Same port labels and parameters as imx708.dtso. Mainline's imx219
 * binding uses VANA/VDIG/VDDL and reg 0x10. The default link frequency
 * is 456 MHz. This repo does not build an imx219 driver; use the one
 * in the kernel.
 */

/dts-v1/;
/plugin/;

/ {
	fragment@0 {
		target = <&cam_port_sensor>;
		__overlay__ {
			compatible = "sony,imx219";
			reg = <0x10>;
			status = "okay";
			clock-names = "xclk";
			orientation = <2>;
			VANA-supply = <&cam_port_reg>;
			VDIG-supply = <&cam_port_reg>;
			VDDL-supply = <&cam_port_reg>;
		};
	};

	fragment@1 {
		target = <&cam_port_sensor_ep>;
		__overlay__ {
			data-lanes = <1 2>;
			clock-noncontinuous;
			link-frequencies = /bits/ 64 <456000000>;
		};
	};

	fragment@2 {
		target = <&cam_port_csi_ep>;
		__overlay__ {
			data-lanes = <1 2>;
			clock-noncontinuous;
			link-frequencies = /bits/ 64 <456000000>;
		};
	};

#include "sensor-isp.dtsi"
};
