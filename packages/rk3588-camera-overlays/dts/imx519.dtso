// SPDX-License-Identifier: (GPL-2.0+ OR MIT)
/*
 * Sony IMX519 (Raspberry Pi / Arducam binding), attached as imx519,port0.
 *
 * Same port labels and parameters as imx708.dtso. Default link frequency
 * is 408 MHz, matching the Pi overlay. No imx519 driver is packaged here.
 */

/dts-v1/;
/plugin/;

/ {
	fragment@0 {
		target = <&cam_port_sensor>;
		__overlay__ {
			compatible = "sony,imx519";
			reg = <0x1a>;
			status = "okay";
			clock-names = "xclk";
			orientation = <2>;
			VANA-supply = <&cam_port_reg>;
			VDIG-supply = <&cam_port_reg>;
			VDDL-supply = <&cam_port_reg>;
		};
	};

	fragment@1 {
		target = <&cam_port_sensor_ep>;
		__overlay__ {
			data-lanes = <1 2>;
			clock-noncontinuous;
			link-frequencies = /bits/ 64 <408000000>;
		};
	};

	fragment@2 {
		target = <&cam_port_csi_ep>;
		__overlay__ {
			data-lanes = <1 2>;
			clock-noncontinuous;
			link-frequencies = /bits/ 64 <408000000>;
		};
	};

#include "sensor-isp.dtsi"
};
